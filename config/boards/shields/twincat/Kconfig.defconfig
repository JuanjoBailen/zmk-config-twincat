## config/boards/shields/twincat/Kconfig.defconfig
```kconfig
if SHIELD_TWINCAT_LEFT

config ZMK_KEYBOARD_NAME
    default "TwinCat"

config ZMK_SPLIT_ROLE_CENTRAL
    default y

endif

if SHIELD_TWINCAT_LEFT || SHIELD_TWINCAT_RIGHT

config ZMK_SPLIT
    default y

endif
```

## config/boards/shields/twincat/Kconfig.shield
```kconfig
config SHIELD_TWINCAT_LEFT
    def_bool $(shields_list_contains, TwinCat_left)

    config SHIELD_TWINCAT_RIGHT
    def_bool $(shields_list_contains, TwinCat_right)
```
